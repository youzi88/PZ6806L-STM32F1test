#include "gui.h"
#include "tftlcd.h"
#include "ascii.h" 

#ifdef ICON_SIZE_58X58
u8 ICON_XLEN = 58;
u8 ICON_YLEN = 58;
u8 ICON_SIZE = 58;

u8 ICON_XFRAM = 10;
u8 ICON_YFRAM = 25;
u8 ICON_XSPACE = 10;
u8 ICON_YSPACE = 30;
#endif

#ifdef ICON_SIZE_48X48
u8 ICON_XLEN = 48;
u8 ICON_YLEN = 48;
u8 ICON_SIZE = 48;

u8 ICON_XFRAM = 10;
u8 ICON_YFRAM = 25;
u8 ICON_XSPACE = 10;
u8 ICON_YSPACE = 30;
#endif

#ifdef ICON_SIZE_38X38
u8 ICON_XLEN = 38;
u8 ICON_YLEN = 38;
u8 ICON_SIZE = 38;

u8 ICON_XFRAM = 10;
u8 ICON_YFRAM = 25;
u8 ICON_XSPACE = 23;
u8 ICON_YSPACE = 25;
#endif





void LCD_ShowCharTrans(u16 x,u16 y,u8 num,u8 size,u8 mode)
{  							  
    u8 temp,t1,t;
	u16 y0=y;
	u8 csize=(size/8+((size%8)?1:0))*(size/2);		//得到字体一个字符对应点阵集所占的字节数	
 	num=num-' ';//得到偏移后的值（ASCII字库是从空格开始取模，所以-' '就是对应字符的字库）
	for(t=0;t<csize;t++)
	{   
		if(size==12)temp=asc_1206[num][t]; 	 	//调用1206字体
		else if(size==16)temp=asc_1608[num][t];	//调用1608字体
		else if(size==24)temp=asc_2412[num][t];	//调用2412字体
		else return;								//没有的字库
		for(t1=0;t1<8;t1++)
		{			    
			if(temp&0x80)LCD_DrawFRONT_COLOR(x,y,WHITE);
			else if(mode==0)LCD_DrawFRONT_COLOR(x,y,BACK_COLOR);
			temp<<=1;
			y++;
			if(y>=tftlcd_data.height)return;		//超区域了
			if((y-y0)==size)
			{
				y=y0;
				x++;
				if(x>=tftlcd_data.width)return;	//超区域了
				break;
			}
		}  	 
	}  	    	   	 	  
}

void LCD_ShowStringTrans(u16 x,u16 y,u16 width,u16 height,u8 size,u8 *p)
{         
	u8 x0=x;
	width+=x;
	height+=y;
    while((*p<='~')&&(*p>=' '))//判断是不是非法字符!
    {       
        if(x>=width){x=x0;y+=size;}
        if(y>=height)break;//退出
        LCD_ShowCharTrans(x,y,*p,size,1);
        x+=size/2;
        p++;
    }  
}



const unsigned char gImage_return[2400] = { /* 0X00,0X10,0X28,0X00,0X1E,0X00,0X01,0X1B, */
0XFF,0X2C,0XFF,0X2C,0XFF,0X2C,0XFF,0X2C,0XFF,0X2C,0XFF,0X2C,0XFF,0X2C,0XFF,0X2C,
0XFF,0X2C,0XFF,0X2C,0XFF,0X2C,0XFF,0X2C,0XFF,0X2C,0XFF,0X2C,0XFF,0X2C,0XFF,0X2C,
0XFF,0X2C,0XFF,0X2C,0XFF,0X2C,0XFF,0X2C,0XFF,0X2C,0XFF,0X2C,0XFF,0X2C,0XFF,0X2C,
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0XFF,0X2C,0XFF,0X2C,0XFF,0X2C,0XFF,0X2C,0XFF,0X2C,0XFF,0X2C,0XFF,0X2C,0XFF,0X2C,
};

